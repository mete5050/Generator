/*  version 0.01; July, 2016
    sound_generator: A arduino waveform generator that uses 3 analog pots for settings and drives a LCD
    hackaday.io/project/12756-a-feature-rich-arduino-waveform-generator
  
    Copyright (C) <2016>  <Joachim Kutzera>

    This program is free software: you can redistribute it and/or modify
    it under the terms of the GNU General Public License as published by
    the Free Software Foundation, either version 3 of the License, or
    (at your option) any later version.

    This program is distributed in the hope that it will be useful,
    but WITHOUT ANY WARRANTY; without even the implied warranty of
    MERCHANTABILITY or FITNESS FOR A PARTICULAR PURPOSE.  See the
    GNU General Public License for more details.

    For a copy of the GNU General Public License
    see <http://www.gnu.org/licenses/>.
*/

// some R-code to make 16384 bytes of sinewave:
// sine = round((sin(seq(0,2*pi, length=16384))+1)*127.7)
// sink("temp.txt")
// for (a in 1:length(sine)) cat(sine[a],",")
// sink()

#include <cheapoPocketCalcDisplayLive.h>
cheapoPocketCalcDisplayLive cp(8,11,9,10,50,50,40); // display at pins 8,11,9,10. 50,50,40 are delay values for keypresses. (larger values = slower)
byte dispPin = 13; // is connected to + when the LCD is switched on to let the arduino know that it is on
boolean dispOn; // when the display is switched on, it needs to be reset to update the number
const byte sinewave[] PROGMEM = {128 ,128 ,128 ,128 ,128 ,128 ,128 ,128 ,128 ,128 ,128 ,128 ,128 ,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128 ,128};
const int Arefs[3][10] = { // reference analog port poti values for the ten digits (a range  middle < value < middle is used to ientify keys)
                        {5,43, 206, 366, 487, 617, 722, 842, 970, 1020},
                        {10,113, 251, 371, 472, 599, 725, 842, 987, 1020},
                        {10,63, 205, 342, 480, 598, 724, 861, 991, 1020}
                      };
const int musicalNotes[] = {131,147,165,175,196, 220, 247, 261, 294, 330, 350, 392, 440, 494, 523, 588, 659, 698, 784, 880, 988, 1046, 1175, 1319};                  
unsigned long waveSize = 16384; // I have 16384 bytes sinewave (this in one forth of the samplingrate) and virtual 16384 tri/sq bytes (calculated on the fly)
// I do the calculation for "from sampleFactor to which position in the sinewave is the next one" with bitshift for higher precision without using floats
byte bitShifter = 2; // everything * 4, for a more precise calculation
byte bitShiftTRI = bitShifter + 5; // helps bringing the y-value for triangle into a range between 0 and 512
byte bitShiftST = bitShifter + 6; // helps bringing the y-value for saw tooth a range between 0 and 256
unsigned long waveSizeScaled = waveSize << bitShifter ; // 4 * upscaled number of sine-values (for more precice calculation)
unsigned long triSizeHalf = waveSizeScaled / 2; // useful for the sawtooth wave
unsigned long squareWavePerc[] = {3276, 9830, 19661, 32768, 45875, 55706, 62259}; // for waveSizeScaled () 5,15,30,50,70,85,95 % square wave
// for the tree analog ports: 0 = freq range, 1 = freq, 2 = mode
int valA[] = {0,0,0}; // value mean of the Analog ports
int setfreq = 0; // the possible next frequency
unsigned long sampleRate = 65536; // amount of cycles per second, (in the interrupt-setup, the sample rate is set by the OCR1A register)
unsigned long nextVal = 0; // the position increment each cycle (can also be 0)
unsigned int wavePos = 0; // the current position in the waveform. value is valid for the bitshifted calculation and will overflow to 0 when waveSizeScaled is reached
unsigned long waveP = 0; // the acual position in the wave-array
unsigned long sampleFactor = sampleRate / waveSize; // is 4 when 16384 values are sampled with 65536 Hz
float correctionFactor = 1.016; // my arduino is a bit off speed-wise, and with that correction (used in acivateFreq()) precision is bang on
unsigned long frequency = 0; // is set according to the poti-positions
unsigned long freqDisplay = 0; // only when the frequency changes by more than 5 Hz, the display is updated
byte delayMultipliers[] = {60,30,3,70,70,70,70,70,70,70}; // some modes need more CPU-oomph so that less is left for my display; adapting the waitcycles for that
byte freqDigits[] = {0,0,0,0,0}; // allows building up the number with the two analog potis (1s, 10s, 100s..)
byte sweepDecVal = 0; // the current decimal value of the sweep poti
byte powerDecVal = 0; // the current decimal value of the power poti
byte modeDecVal = 0; // the current decimal value of the mode button
byte oldMode = 0; // when the mode changes, i need to reset some stuff

void setup() {
  cp.reset();
  activateFreq();
  freqDisplay = frequency;
  pinMode(dispPin, INPUT);
  //set port/pin  mode
  //TIMER INTERRUPT SETUP
  DDRD = 0xFF;//all outputs
  DDRC = 0x00;//analog inputs
  DDRB = 0x00;//digital inputs
  cli();//disable interrupts
  Serial.end(); // begin(9600);
  //set timer1 interrupt at 65536kHz
  TCCR1A = 0;// set entire TCCR1A register to 0
  TCCR1B = 0;// same for TCCR1B
  TCNT1  = 0;//initialize counter value to 0;
  // set timer count for 65536khz increments
  OCR1A =30;// = (16*10^6) / (65536*8) - 1
  // turn on CTC mode
  TCCR1B |= (1 << WGM12);
  // Set CS11 bit for 8 prescaler
  TCCR1B |= (1 << CS11);   
  // enable timer compare interrupt
  TIMSK1 |= (1 << OCIE1A);
  sei(); // enable interrupts
}
 
ISR(TIMER1_COMPA_vect){  // the timer-driven interrupt routine
  wavePos = wavePos + nextVal;
  if (modeDecVal == 0){ // sine wave 
    waveP = wavePos >> bitShifter;
    PORTD = pgm_read_byte_near(sinewave + waveP);
  }
  if (modeDecVal == 1){// sawtooth wave
    PORTD = wavePos >> bitShiftST;     
    }
  if (modeDecVal == 2){// triangle wave
    if (wavePos < triSizeHalf)
      PORTD = wavePos >> bitShiftTRI;
    if (wavePos > triSizeHalf)
      PORTD = (waveSizeScaled-wavePos) >> bitShiftTRI;
    }  
  if (modeDecVal > 2){// square wave
    if (wavePos < squareWavePerc[modeDecVal-3]) 
      PORTD = 255;
    else
      PORTD = 0;
    }
  }
void activateFreq(){ // calculates the nextval-value for the current frequency
  unsigned long freq;
  freq = frequency * correctionFactor;
  nextVal = (freq << bitShifter) / sampleFactor;  
  }
byte getDecVal(byte whichA){ // returns the decimal value (0-9) for the requested analog port
  byte retval = 0;
  if (valA[whichA] >= Arefs[whichA][9])
    retval = 9;
  else
    while (Arefs[whichA][retval] + ( (Arefs[whichA][retval+1] - Arefs[whichA][retval])/2 ) < valA[whichA] && retval < 8)
      retval ++;  
  return (retval);
  }
void setCurrentFreq(){ // gets current frequency from the poti positions
  sweepDecVal = getDecVal(0);
  powerDecVal = getDecVal(1);
  modeDecVal =  getDecVal(2);
  if (modeDecVal != oldMode)
    activateFreq();
      if (powerDecVal <= 4){  
        freqDigits[powerDecVal] = sweepDecVal;
        setfreq = freqDigits[4]*10000 + freqDigits[3]*1000 + freqDigits[2]*100 + freqDigits[1]*10 + freqDigits[0];
        }
      if (powerDecVal == 5)
        setfreq = valA[0];
      if (powerDecVal == 6)
        setfreq = 1000 + (valA[0] * 8.79);  
      if (powerDecVal > 6)
        setfreq = musicalNotes[(powerDecVal-7)*7 + sweepDecVal];
      if (setfreq != frequency){
        frequency = setfreq;
        activateFreq();
        }
  oldMode = modeDecVal;    
  }
void loop() {
    if (digitalRead(dispPin) == 1){
      if (!dispOn){
        cp.reset();
        freqDisplay = frequency;
        dispOn = true;
        }
      if ((freqDisplay < frequency-2)||(freqDisplay > frequency+2)) // avoids a too shaky number in sweep mode
        freqDisplay = frequency;
      if (powerDecVal < 5)
        freqDisplay = frequency;  
      cp.setMultiplier(delayMultipliers[modeDecVal]); // having the display update reasonably fast in each waveform requires different multipliers
      cp.writeNumber(freqDisplay);
      }else{
        dispOn = false; 
        }
    for (byte a=0;a<3;a++) // reading the current values of the 3 pots
      valA[a] = analogRead(a);
      setCurrentFreq();
  }
